## arch/arm/mach-exynos/Kconfig.local
```kconfig
choice
	prompt "Target Locale"
	default TARGET_LOCALE_EUR

config TARGET_LOCALE_EUR
	bool "Europe Open"

config TARGET_LOCALE_LTN
	bool "Latin"

config TARGET_LOCALE_KOR
	bool "Kor"

config TARGET_LOCALE_NAATT_TEMP
	bool "NAGSM"

config TARGET_LOCALE_NA
	bool "NA"

config TARGET_LOCALE_EUR_U1_NFC
	bool "Europe Open NFC"

config TARGET_LOCALE_NTT
	bool "JPN DCM"

config TARGET_LOCALE_JPN
	bool "JPN"

config TARGET_LOCALE_CHN
	bool "CHN"

config TARGET_LOCALE_USA
	bool "USA"

endchoice

choice
	prompt "C1 USA Target Carrier"
	depends on MACH_C1 && (TARGET_LOCALE_EUR || TARGET_LOCALE_USA)
	default MACH_C1_USA_ATT

config MACH_C1_USA_ATT
	bool "ATT"

config MACH_C1_USA_VZW
	bool "VZW"
endchoice

choice
	prompt "C2 USA Target Carrier"
	depends on MACH_M3 && TARGET_LOCALE_USA
	default MACH_M3_USA_VZW

config MACH_M3_USA_VZW
	bool "C2 Verizon"

config MACH_M3_USA_SPR
	bool "C2 Sprint"
endchoice

choice
	prompt "U1 KOR Target Carrier"
	depends on MACH_U1 && TARGET_LOCALE_KOR
	default MACH_U1_KOR_SKT

config MACH_U1_KOR_SKT
	bool "SKT"

config MACH_U1_KOR_KT
	bool "KT"

config MACH_U1_KOR_LGT
	bool "LG U+"
endchoice

choice
	prompt "C1 KOR Target Carrier"
	depends on MACH_C1 && TARGET_LOCALE_KOR
	default MACH_C1_KOR_SKT

config MACH_C1_KOR_SKT
	bool "SKT"

config MACH_C1_KOR_KT
	bool "KT"

config MACH_C1_KOR_LGT
	bool "LG U+"
endchoice

choice
	prompt "M0 KOR Target Carrier"
	depends on MACH_M0 && TARGET_LOCALE_KOR
	default MACH_M0_KOR_SKT

config MACH_M0_KOR_SKT
	bool "SKT"

config MACH_M0_KOR_KT
	bool "KT"

config MACH_M0_KOR_LGT
	bool "LG U+"
endchoice

choice
	prompt "M0 Chinese Target Carrier"
	depends on (MACH_M0 || MACH_GRANDE) && TARGET_LOCALE_CHN

config MACH_M0_CMCC
	bool "M0 CHN CMCC board"

config MACH_M0_CHNOPEN
	bool "M0 CHN OPEN board"

config MACH_M0_HKTW
	bool "M0 CHN HKTW board"

config MACH_M0_CTC
	bool "M0 CHN CTC board"
endchoice

menu "M0 CTC based models"
	depends on MACH_M0_CTC && TARGET_LOCALE_CHN

config MACH_M0_GRANDECTC
	bool "M0 CHN GRANDE CTC board"

config MACH_M0_DUOSCTC
	bool "M0 CHN DUOS CTC board"

endmenu
```

## drivers/gpu/arm/mali400/Kconfig
```kconfig
menuconfig MALI400
	tristate "Mali-400 support"
	default n
	depends on ARM
	select DMA_SHARED_BUFFER
	---help---
	  This enables support for the ARM Mali-400 GPUs.

	  To compile this driver as a module, choose M here: the module will be
	  called mali.

choice
depends on MALI400
prompt "Select MALI VER"
default MALI_VER_R3P2_REL0

config MALI_VER_R3P2_REL0
	bool "Mali400 Version R3P2-REL0"
	help
	  Choose this option to select Mali400 DDK R3P2-REL0 version.

if MALI_VER_R3P2_REL0
source "drivers/gpu/arm/mali400/mali/Kconfig"
endif

config MALI_VER_R4P0_REL0
	bool "Mali400 Version R4P0-REL0"
	help
	  Choose this option to select Mali400 DDK R4P0-REL0 version.

if MALI_VER_R4P0_REL0
source "drivers/gpu/arm/mali400/r4p0_rel0/Kconfig"
endif

endchoice
```

## drivers/gpu/mali400/r3p2/ump/Kconfig
```kconfig
config UMP
        bool "Enable UMP(Unified Memory Provider)"
        default n 
	---help---
		This enables UMP memory provider

config UMP_MEM_SIZE
	int "UMP Memory Size"
	depends on UMP
	default "64"
	---help---
		This value decide memory size of UMP (unit is MByte).

config UMP_DEBUG
	bool "Enables debug messages"
	depends on UMP
	default n
	---help---
		This enables UMP driver debug messages

config ION_IMPORT
	bool "Enables ION import inside of UMP driver"
	depends on UMP && ION 
	default n
	---help---
		This enables ION import insidef of UMP driver
```

## drivers/haptic/Kconfig
```kconfig
menuconfig HAPTIC
	bool "Haptic support"
	help
	  Say Y to enalbe haptic support.
	  It enables the haptic and controlled
	  from both userspace and kernel

if HAPTIC

config HAPTIC_CLASS
	tristate "Haptic Class Support"
	help
	  Say Y to enable haptic class support.
	  This option enables the haptic sysfs class
	  in /sys/class/haptic.


comment "Haptic chips"

config HAPTIC_MAX8997
	tristate "MAX8997 haptic controller"
	depends on HAPTIC_CLASS && I2C
	help
	  The MAX8997(PMIC) has a haptic controller.

config HAPTIC_MAX77693
	tristate "MAX77693 haptic controller"
	depends on HAPTIC_CLASS && I2C
	help
	  The MAX77693(PMIC) has a haptic controller.

endif	# HAPTIC
```

## drivers/sensorhub/Kconfig
```kconfig
#
# sensor drivers configuration
#
config SENSORS_SYSFS
	tristate "Sensors sysfs"
	help
	  Support sysfs for sensors.
          If you say yes here you get sysfs support for
	  sensor factory test.
	  To compile this driver as a module, choose M here: the
	  module will be called sensors_core.

config SENSORS_SSP
	tristate "Sensors ssp"
	default n
	depends on I2C
	help
	  ssp driver for sensor hub.
          If you say yes here you get ssp support for
	  sensor hub.
	  To compile this driver as a module, choose M here: the
	  module will be called ssp.

config SENSORS_SSP_ACCELEROMETER_POSITION
	int "Accelerometer Sensor Mounting Position on Board"
	depends on SENSORS_SSP
	default "0"
	help
	  X Y Z axis position.
	    0:  X, Y, Z
	    1:  Y,-X, Z
	    2: -X,-Y, Z
	    3: -Y, X, Z
	    4: -X, Y,-Z
	    5:  Y, X,-Z
	    6:  X,-Y,-Z
	    7: -Y,-X,-Z

config SENSORS_SSP_GYROSCOPE_POSITION
	int "Gyroscope Sensor Mounting Position on Board"
	depends on SENSORS_SSP
	default "0"
	help
	  X Y Z axis position.
	    0:  X, Y, Z
	    1:  Y,-X, Z
	    2: -X,-Y, Z
	    3: -Y, X, Z
	    4: -X, Y,-Z
	    5:  Y, X,-Z
	    6:  X,-Y,-Z
	    7: -Y,-X,-Z

config SENSORS_SSP_MAGNETOMETER_POSITION
	int "Geomagnetic Sensor Mounting Position on Board"
	depends on SENSORS_SSP
	default "0"
	help
	  X Y Z axis position.
	    0:  X, Y, Z
	    1:  Y,-X, Z
	    2: -X,-Y, Z
	    3: -Y, X, Z
	    4: -X, Y,-Z
	    5:  Y, X,-Z
	    6:  X,-Y,-Z
	    7: -Y,-X,-Z

config SENSORS_SSP_SENSORHUB
	tristate "Sensors ssp sensorhub"
	default n
	depends on I2C
	help
	  ssp sensor hub driver for sensor hub.
          If you say yes here you get ssp support for
	  sensor hub.
	  To compile this driver as a module, choose M here: the
	  module will be called ssp.
```
